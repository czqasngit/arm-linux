## uboot/uboot-imx-yxb-4.1.15_2.1.0_ga/board/freescale/mx6ull_yxb_emmc/Kconfig
```kconfig
if TARGET_MX6ULL_YXB_EMMC

config SYS_BOARD
	default "mx6ull_yxb_emmc"

config SYS_VENDOR
	default "freescale"
    
config SYS_SOC
    default "mx6"

config SYS_CONFIG_NAME
	default "mx6ull_yxb_emmc"

endif
```
